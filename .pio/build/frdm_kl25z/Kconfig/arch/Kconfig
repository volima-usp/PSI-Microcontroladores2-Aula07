## .pio/build/frdm_kl25z/Kconfig/arch/Kconfig
```kconfig
# Load Zephyr Arch Kconfig descriptions.
osource "C:/Users/Administrador/.platformio/packages/framework-zephyr@3.40200.0/arch/rx/Kconfig"
osource "C:/Users/Administrador/.platformio/packages/framework-zephyr@3.40200.0/arch/x86/Kconfig"
osource "C:/Users/Administrador/.platformio/packages/framework-zephyr@3.40200.0/arch/xtensa/Kconfig"
osource "C:/Users/Administrador/.platformio/packages/framework-zephyr@3.40200.0/arch/sparc/Kconfig"
osource "C:/Users/Administrador/.platformio/packages/framework-zephyr@3.40200.0/arch/riscv/Kconfig"
osource "C:/Users/Administrador/.platformio/packages/framework-zephyr@3.40200.0/arch/posix/Kconfig"
osource "C:/Users/Administrador/.platformio/packages/framework-zephyr@3.40200.0/arch/mips/Kconfig"
osource "C:/Users/Administrador/.platformio/packages/framework-zephyr@3.40200.0/arch/arm64/Kconfig"
osource "C:/Users/Administrador/.platformio/packages/framework-zephyr@3.40200.0/arch/arm/Kconfig"
osource "C:/Users/Administrador/.platformio/packages/framework-zephyr@3.40200.0/arch/arc/Kconfig"
```

## .pio/build/frdm_kl25z/Kconfig/boards/Kconfig.defconfig
```kconfig
# Load Zephyr board defconfig descriptions.
osource "C:/Users/Administrador/.platformio/packages/framework-zephyr@3.40200.0/boards/nxp/frdm_kl25z/Kconfig.defconfig"
```

## .pio/build/frdm_kl25z/Kconfig/soc/Kconfig
```kconfig
# Load Zephyr SoC Kconfig descriptions.
osource "C:/Users/Administrador/.platformio/packages/framework-zephyr@3.40200.0/soc/xlnx/zynqmp/Kconfig"
osource "C:/Users/Administrador/.platformio/packages/framework-zephyr@3.40200.0/soc/xlnx/zynq7000/Kconfig"
osource "C:/Users/Administrador/.platformio/packages/framework-zephyr@3.40200.0/soc/xlnx/versalnet/Kconfig"
osource "C:/Users/Administrador/.platformio/packages/framework-zephyr@3.40200.0/soc/xlnx/versal2/Kconfig"
osource "C:/Users/Administrador/.platformio/packages/framework-zephyr@3.40200.0/soc/xen/Kconfig"
osource "C:/Users/Administrador/.platformio/packages/framework-zephyr@3.40200.0/soc/wch/ch32v/Kconfig"
osource "C:/Users/Administrador/.platformio/packages/framework-zephyr@3.40200.0/soc/ti/simplelink/Kconfig"
osource "C:/Users/Administrador/.platformio/packages/framework-zephyr@3.40200.0/soc/ti/mspm0/Kconfig"
osource "C:/Users/Administrador/.platformio/packages/framework-zephyr@3.40200.0/soc/ti/lm3s6965/Kconfig"
osource "C:/Users/Administrador/.platformio/packages/framework-zephyr@3.40200.0/soc/ti/k3/Kconfig"
osource "C:/Users/Administrador/.platformio/packages/framework-zephyr@3.40200.0/soc/telink/tlsr/Kconfig"
osource "C:/Users/Administrador/.platformio/packages/framework-zephyr@3.40200.0/soc/starfive/jh71xx/Kconfig"
osource "C:/Users/Administrador/.platformio/packages/framework-zephyr@3.40200.0/soc/st/stm32/Kconfig"
osource "C:/Users/Administrador/.platformio/packages/framework-zephyr@3.40200.0/soc/snps/qemu_arc/Kconfig"
osource "C:/Users/Administrador/.platformio/packages/framework-zephyr@3.40200.0/soc/snps/nsim/arc_v/Kconfig"
osource "C:/Users/Administrador/.platformio/packages/framework-zephyr@3.40200.0/soc/snps/nsim/arc_classic/Kconfig"
osource "C:/Users/Administrador/.platformio/packages/framework-zephyr@3.40200.0/soc/snps/hsdk4xd/Kconfig"
osource "C:/Users/Administrador/.platformio/packages/framework-zephyr@3.40200.0/soc/snps/hsdk/Kconfig"
osource "C:/Users/Administrador/.platformio/packages/framework-zephyr@3.40200.0/soc/snps/emsk/Kconfig"
osource "C:/Users/Administrador/.platformio/packages/framework-zephyr@3.40200.0/soc/snps/emsdp/Kconfig"
osource "C:/Users/Administrador/.platformio/packages/framework-zephyr@3.40200.0/soc/snps/arc_iot/Kconfig"
osource "C:/Users/Administrador/.platformio/packages/framework-zephyr@3.40200.0/soc/silabs/Kconfig"
osource "C:/Users/Administrador/.platformio/packages/framework-zephyr@3.40200.0/soc/sifive/sifive_freedom/Kconfig"
osource "C:/Users/Administrador/.platformio/packages/framework-zephyr@3.40200.0/soc/sensry/Kconfig"
osource "C:/Users/Administrador/.platformio/packages/framework-zephyr@3.40200.0/soc/rockchip/Kconfig"
osource "C:/Users/Administrador/.platformio/packages/framework-zephyr@3.40200.0/soc/renode/riscv_virtual/Kconfig"
osource "C:/Users/Administrador/.platformio/packages/framework-zephyr@3.40200.0/soc/renode/cortex_r8_virtual/Kconfig"
osource "C:/Users/Administrador/.platformio/packages/framework-zephyr@3.40200.0/soc/renesas/smartbond/Kconfig"
osource "C:/Users/Administrador/.platformio/packages/framework-zephyr@3.40200.0/soc/renesas/rz/Kconfig"
osource "C:/Users/Administrador/.platformio/packages/framework-zephyr@3.40200.0/soc/renesas/rx/Kconfig"
osource "C:/Users/Administrador/.platformio/packages/framework-zephyr@3.40200.0/soc/renesas/rcar/Kconfig"
osource "C:/Users/Administrador/.platformio/packages/framework-zephyr@3.40200.0/soc/renesas/ra/Kconfig"
osource "C:/Users/Administrador/.platformio/packages/framework-zephyr@3.40200.0/soc/realtek/ec/Kconfig"
osource "C:/Users/Administrador/.platformio/packages/framework-zephyr@3.40200.0/soc/raspberrypi/rpi_pico/Kconfig"
osource "C:/Users/Administrador/.platformio/packages/framework-zephyr@3.40200.0/soc/quicklogic/eos_s3/Kconfig"
osource "C:/Users/Administrador/.platformio/packages/framework-zephyr@3.40200.0/soc/qemu/virt_riscv/Kconfig"
osource "C:/Users/Administrador/.platformio/packages/framework-zephyr@3.40200.0/soc/qemu/malta/Kconfig"
osource "C:/Users/Administrador/.platformio/packages/framework-zephyr@3.40200.0/soc/openisa/rv32m1/Kconfig"
osource "C:/Users/Administrador/.platformio/packages/framework-zephyr@3.40200.0/soc/openhwgroup/cva6/Kconfig"
osource "C:/Users/Administrador/.platformio/packages/framework-zephyr@3.40200.0/soc/oct/osd32mp15x/Kconfig"
osource "C:/Users/Administrador/.platformio/packages/framework-zephyr@3.40200.0/soc/nxp/s32/Kconfig"
osource "C:/Users/Administrador/.platformio/packages/framework-zephyr@3.40200.0/soc/nxp/rw/Kconfig"
osource "C:/Users/Administrador/.platformio/packages/framework-zephyr@3.40200.0/soc/nxp/mcx/Kconfig"
osource "C:/Users/Administrador/.platformio/packages/framework-zephyr@3.40200.0/soc/nxp/lpc/Kconfig"
osource "C:/Users/Administrador/.platformio/packages/framework-zephyr@3.40200.0/soc/nxp/layerscape/Kconfig"
osource "C:/Users/Administrador/.platformio/packages/framework-zephyr@3.40200.0/soc/nxp/kinetis/Kconfig"
osource "C:/Users/Administrador/.platformio/packages/framework-zephyr@3.40200.0/soc/nxp/imxrt/Kconfig"
osource "C:/Users/Administrador/.platformio/packages/framework-zephyr@3.40200.0/soc/nxp/imx/Kconfig"
osource "C:/Users/Administrador/.platformio/packages/framework-zephyr@3.40200.0/soc/nuvoton/numicro/Kconfig"
osource "C:/Users/Administrador/.platformio/packages/framework-zephyr@3.40200.0/soc/nuvoton/numaker/Kconfig"
osource "C:/Users/Administrador/.platformio/packages/framework-zephyr@3.40200.0/soc/nuvoton/npcx/Kconfig"
osource "C:/Users/Administrador/.platformio/packages/framework-zephyr@3.40200.0/soc/nuvoton/npcm/Kconfig"
osource "C:/Users/Administrador/.platformio/packages/framework-zephyr@3.40200.0/soc/nordic/Kconfig"
osource "C:/Users/Administrador/.platformio/packages/framework-zephyr@3.40200.0/soc/neorv32/Kconfig"
osource "C:/Users/Administrador/.platformio/packages/framework-zephyr@3.40200.0/soc/native/inf_clock/Kconfig"
osource "C:/Users/Administrador/.platformio/packages/framework-zephyr@3.40200.0/soc/microchip/sam/Kconfig"
osource "C:/Users/Administrador/.platformio/packages/framework-zephyr@3.40200.0/soc/microchip/miv/Kconfig"
osource "C:/Users/Administrador/.platformio/packages/framework-zephyr@3.40200.0/soc/microchip/mec/Kconfig"
osource "C:/Users/Administrador/.platformio/packages/framework-zephyr@3.40200.0/soc/mediatek/mt8xxx/Kconfig"
osource "C:/Users/Administrador/.platformio/packages/framework-zephyr@3.40200.0/soc/lowrisc/opentitan/Kconfig"
osource "C:/Users/Administrador/.platformio/packages/framework-zephyr@3.40200.0/soc/litex/litex_vexriscv/Kconfig"
osource "C:/Users/Administrador/.platformio/packages/framework-zephyr@3.40200.0/soc/ite/ec/Kconfig"
osource "C:/Users/Administrador/.platformio/packages/framework-zephyr@3.40200.0/soc/intel/raptor_lake/Kconfig"
osource "C:/Users/Administrador/.platformio/packages/framework-zephyr@3.40200.0/soc/intel/lakemont/Kconfig"
osource "C:/Users/Administrador/.platformio/packages/framework-zephyr@3.40200.0/soc/intel/intel_socfpga_std/Kconfig"
osource "C:/Users/Administrador/.platformio/packages/framework-zephyr@3.40200.0/soc/intel/intel_socfpga/Kconfig"
osource "C:/Users/Administrador/.platformio/packages/framework-zephyr@3.40200.0/soc/intel/intel_niosv/Kconfig"
osource "C:/Users/Administrador/.platformio/packages/framework-zephyr@3.40200.0/soc/intel/intel_ish/Kconfig"
osource "C:/Users/Administrador/.platformio/packages/framework-zephyr@3.40200.0/soc/intel/intel_adsp/Kconfig"
osource "C:/Users/Administrador/.platformio/packages/framework-zephyr@3.40200.0/soc/intel/elkhart_lake/Kconfig"
osource "C:/Users/Administrador/.platformio/packages/framework-zephyr@3.40200.0/soc/intel/atom/Kconfig"
osource "C:/Users/Administrador/.platformio/packages/framework-zephyr@3.40200.0/soc/intel/apollo_lake/Kconfig"
osource "C:/Users/Administrador/.platformio/packages/framework-zephyr@3.40200.0/soc/intel/alder_lake/Kconfig"
osource "C:/Users/Administrador/.platformio/packages/framework-zephyr@3.40200.0/soc/infineon/cat3/Kconfig"
osource "C:/Users/Administrador/.platformio/packages/framework-zephyr@3.40200.0/soc/infineon/cat1c/Kconfig"
osource "C:/Users/Administrador/.platformio/packages/framework-zephyr@3.40200.0/soc/infineon/cat1b/Kconfig"
osource "C:/Users/Administrador/.platformio/packages/framework-zephyr@3.40200.0/soc/infineon/cat1a/Kconfig"
osource "C:/Users/Administrador/.platformio/packages/framework-zephyr@3.40200.0/soc/gd/gd32/Kconfig"
osource "C:/Users/Administrador/.platformio/packages/framework-zephyr@3.40200.0/soc/gaisler/leon3/Kconfig"
osource "C:/Users/Administrador/.platformio/packages/framework-zephyr@3.40200.0/soc/gaisler/gr716a/Kconfig"
osource "C:/Users/Administrador/.platformio/packages/framework-zephyr@3.40200.0/soc/espressif/Kconfig"
osource "C:/Users/Administrador/.platformio/packages/framework-zephyr@3.40200.0/soc/ene/kb1200/Kconfig"
osource "C:/Users/Administrador/.platformio/packages/framework-zephyr@3.40200.0/soc/ene/kb106x/Kconfig"
osource "C:/Users/Administrador/.platformio/packages/framework-zephyr@3.40200.0/soc/efinix/sapphire/Kconfig"
osource "C:/Users/Administrador/.platformio/packages/framework-zephyr@3.40200.0/soc/cdns/xtensa_sample_controller/Kconfig"
osource "C:/Users/Administrador/.platformio/packages/framework-zephyr@3.40200.0/soc/cdns/sample_controller32/Kconfig"
osource "C:/Users/Administrador/.platformio/packages/framework-zephyr@3.40200.0/soc/cdns/dc233c/Kconfig"
osource "C:/Users/Administrador/.platformio/packages/framework-zephyr@3.40200.0/soc/brcm/bcmvk/Kconfig"
osource "C:/Users/Administrador/.platformio/packages/framework-zephyr@3.40200.0/soc/brcm/bcm2712/Kconfig"
osource "C:/Users/Administrador/.platformio/packages/framework-zephyr@3.40200.0/soc/brcm/bcm2711/Kconfig"
osource "C:/Users/Administrador/.platformio/packages/framework-zephyr@3.40200.0/soc/bflb/Kconfig"
osource "C:/Users/Administrador/.platformio/packages/framework-zephyr@3.40200.0/soc/atmel/sam0/Kconfig"
osource "C:/Users/Administrador/.platformio/packages/framework-zephyr@3.40200.0/soc/atmel/sam/Kconfig"
osource "C:/Users/Administrador/.platformio/packages/framework-zephyr@3.40200.0/soc/aspeed/Kconfig"
osource "C:/Users/Administrador/.platformio/packages/framework-zephyr@3.40200.0/soc/arm/Kconfig"
osource "C:/Users/Administrador/.platformio/packages/framework-zephyr@3.40200.0/soc/arm/beetle/Kconfig"
osource "C:/Users/Administrador/.platformio/packages/framework-zephyr@3.40200.0/soc/antmicro/myra/Kconfig"
osource "C:/Users/Administrador/.platformio/packages/framework-zephyr@3.40200.0/soc/andestech/Kconfig"
osource "C:/Users/Administrador/.platformio/packages/framework-zephyr@3.40200.0/soc/amd/acp_6_0/Kconfig"
osource "C:/Users/Administrador/.platformio/packages/framework-zephyr@3.40200.0/soc/ambiq/Kconfig"
osource "C:/Users/Administrador/.platformio/packages/framework-zephyr@3.40200.0/soc/aesc/Kconfig"
osource "C:/Users/Administrador/.platformio/packages/framework-zephyr@3.40200.0/soc/adi/max32/Kconfig"
```
