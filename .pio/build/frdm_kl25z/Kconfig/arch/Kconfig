## .pio/build/frdm_kl25z/Kconfig/soc/Kconfig.soc
```kconfig
# Load SoC Kconfig descriptions.
osource "C:/Users/Administrador/.platformio/packages/framework-zephyr@3.40200.0/soc/xlnx/zynqmp/Kconfig.soc"
osource "C:/Users/Administrador/.platformio/packages/framework-zephyr@3.40200.0/soc/xlnx/zynq7000/Kconfig.soc"
osource "C:/Users/Administrador/.platformio/packages/framework-zephyr@3.40200.0/soc/xlnx/versalnet/Kconfig.soc"
osource "C:/Users/Administrador/.platformio/packages/framework-zephyr@3.40200.0/soc/xlnx/versal2/Kconfig.soc"
osource "C:/Users/Administrador/.platformio/packages/framework-zephyr@3.40200.0/soc/xen/Kconfig.soc"
osource "C:/Users/Administrador/.platformio/packages/framework-zephyr@3.40200.0/soc/wch/ch32v/Kconfig.soc"
osource "C:/Users/Administrador/.platformio/packages/framework-zephyr@3.40200.0/soc/ti/simplelink/Kconfig.soc"
osource "C:/Users/Administrador/.platformio/packages/framework-zephyr@3.40200.0/soc/ti/mspm0/Kconfig.soc"
osource "C:/Users/Administrador/.platformio/packages/framework-zephyr@3.40200.0/soc/ti/lm3s6965/Kconfig.soc"
osource "C:/Users/Administrador/.platformio/packages/framework-zephyr@3.40200.0/soc/ti/k3/Kconfig.soc"
osource "C:/Users/Administrador/.platformio/packages/framework-zephyr@3.40200.0/soc/telink/tlsr/Kconfig.soc"
osource "C:/Users/Administrador/.platformio/packages/framework-zephyr@3.40200.0/soc/starfive/jh71xx/Kconfig.soc"
osource "C:/Users/Administrador/.platformio/packages/framework-zephyr@3.40200.0/soc/st/stm32/Kconfig.soc"
osource "C:/Users/Administrador/.platformio/packages/framework-zephyr@3.40200.0/soc/snps/qemu_arc/Kconfig.soc"
osource "C:/Users/Administrador/.platformio/packages/framework-zephyr@3.40200.0/soc/snps/nsim/arc_v/Kconfig.soc"
osource "C:/Users/Administrador/.platformio/packages/framework-zephyr@3.40200.0/soc/snps/nsim/arc_classic/Kconfig.soc"
osource "C:/Users/Administrador/.platformio/packages/framework-zephyr@3.40200.0/soc/snps/hsdk4xd/Kconfig.soc"
osource "C:/Users/Administrador/.platformio/packages/framework-zephyr@3.40200.0/soc/snps/hsdk/Kconfig.soc"
osource "C:/Users/Administrador/.platformio/packages/framework-zephyr@3.40200.0/soc/snps/emsk/Kconfig.soc"
osource "C:/Users/Administrador/.platformio/packages/framework-zephyr@3.40200.0/soc/snps/emsdp/Kconfig.soc"
osource "C:/Users/Administrador/.platformio/packages/framework-zephyr@3.40200.0/soc/snps/arc_iot/Kconfig.soc"
osource "C:/Users/Administrador/.platformio/packages/framework-zephyr@3.40200.0/soc/silabs/Kconfig.soc"
osource "C:/Users/Administrador/.platformio/packages/framework-zephyr@3.40200.0/soc/sifive/sifive_freedom/Kconfig.soc"
osource "C:/Users/Administrador/.platformio/packages/framework-zephyr@3.40200.0/soc/sensry/Kconfig.soc"
osource "C:/Users/Administrador/.platformio/packages/framework-zephyr@3.40200.0/soc/rockchip/Kconfig.soc"
osource "C:/Users/Administrador/.platformio/packages/framework-zephyr@3.40200.0/soc/renode/riscv_virtual/Kconfig.soc"
osource "C:/Users/Administrador/.platformio/packages/framework-zephyr@3.40200.0/soc/renode/cortex_r8_virtual/Kconfig.soc"
osource "C:/Users/Administrador/.platformio/packages/framework-zephyr@3.40200.0/soc/renesas/smartbond/Kconfig.soc"
osource "C:/Users/Administrador/.platformio/packages/framework-zephyr@3.40200.0/soc/renesas/rz/Kconfig.soc"
osource "C:/Users/Administrador/.platformio/packages/framework-zephyr@3.40200.0/soc/renesas/rx/Kconfig.soc"
osource "C:/Users/Administrador/.platformio/packages/framework-zephyr@3.40200.0/soc/renesas/rcar/Kconfig.soc"
osource "C:/Users/Administrador/.platformio/packages/framework-zephyr@3.40200.0/soc/renesas/ra/Kconfig.soc"
osource "C:/Users/Administrador/.platformio/packages/framework-zephyr@3.40200.0/soc/realtek/ec/Kconfig.soc"
osource "C:/Users/Administrador/.platformio/packages/framework-zephyr@3.40200.0/soc/raspberrypi/rpi_pico/Kconfig.soc"
osource "C:/Users/Administrador/.platformio/packages/framework-zephyr@3.40200.0/soc/quicklogic/eos_s3/Kconfig.soc"
osource "C:/Users/Administrador/.platformio/packages/framework-zephyr@3.40200.0/soc/qemu/virt_riscv/Kconfig.soc"
osource "C:/Users/Administrador/.platformio/packages/framework-zephyr@3.40200.0/soc/qemu/malta/Kconfig.soc"
osource "C:/Users/Administrador/.platformio/packages/framework-zephyr@3.40200.0/soc/openisa/rv32m1/Kconfig.soc"
osource "C:/Users/Administrador/.platformio/packages/framework-zephyr@3.40200.0/soc/openhwgroup/cva6/Kconfig.soc"
osource "C:/Users/Administrador/.platformio/packages/framework-zephyr@3.40200.0/soc/oct/osd32mp15x/Kconfig.soc"
osource "C:/Users/Administrador/.platformio/packages/framework-zephyr@3.40200.0/soc/nxp/s32/Kconfig.soc"
osource "C:/Users/Administrador/.platformio/packages/framework-zephyr@3.40200.0/soc/nxp/rw/Kconfig.soc"
osource "C:/Users/Administrador/.platformio/packages/framework-zephyr@3.40200.0/soc/nxp/mcx/Kconfig.soc"
osource "C:/Users/Administrador/.platformio/packages/framework-zephyr@3.40200.0/soc/nxp/lpc/Kconfig.soc"
osource "C:/Users/Administrador/.platformio/packages/framework-zephyr@3.40200.0/soc/nxp/layerscape/Kconfig.soc"
osource "C:/Users/Administrador/.platformio/packages/framework-zephyr@3.40200.0/soc/nxp/kinetis/Kconfig.soc"
osource "C:/Users/Administrador/.platformio/packages/framework-zephyr@3.40200.0/soc/nxp/imxrt/Kconfig.soc"
osource "C:/Users/Administrador/.platformio/packages/framework-zephyr@3.40200.0/soc/nxp/imx/Kconfig.soc"
osource "C:/Users/Administrador/.platformio/packages/framework-zephyr@3.40200.0/soc/nuvoton/numicro/Kconfig.soc"
osource "C:/Users/Administrador/.platformio/packages/framework-zephyr@3.40200.0/soc/nuvoton/numaker/Kconfig.soc"
osource "C:/Users/Administrador/.platformio/packages/framework-zephyr@3.40200.0/soc/nuvoton/npcx/Kconfig.soc"
osource "C:/Users/Administrador/.platformio/packages/framework-zephyr@3.40200.0/soc/nuvoton/npcm/Kconfig.soc"
osource "C:/Users/Administrador/.platformio/packages/framework-zephyr@3.40200.0/soc/nordic/Kconfig.soc"
osource "C:/Users/Administrador/.platformio/packages/framework-zephyr@3.40200.0/soc/neorv32/Kconfig.soc"
osource "C:/Users/Administrador/.platformio/packages/framework-zephyr@3.40200.0/soc/native/inf_clock/Kconfig.soc"
osource "C:/Users/Administrador/.platformio/packages/framework-zephyr@3.40200.0/soc/microchip/sam/Kconfig.soc"
osource "C:/Users/Administrador/.platformio/packages/framework-zephyr@3.40200.0/soc/microchip/miv/Kconfig.soc"
osource "C:/Users/Administrador/.platformio/packages/framework-zephyr@3.40200.0/soc/microchip/mec/Kconfig.soc"
osource "C:/Users/Administrador/.platformio/packages/framework-zephyr@3.40200.0/soc/mediatek/mt8xxx/Kconfig.soc"
osource "C:/Users/Administrador/.platformio/packages/framework-zephyr@3.40200.0/soc/lowrisc/opentitan/Kconfig.soc"
osource "C:/Users/Administrador/.platformio/packages/framework-zephyr@3.40200.0/soc/litex/litex_vexriscv/Kconfig.soc"
osource "C:/Users/Administrador/.platformio/packages/framework-zephyr@3.40200.0/soc/ite/ec/Kconfig.soc"
osource "C:/Users/Administrador/.platformio/packages/framework-zephyr@3.40200.0/soc/intel/raptor_lake/Kconfig.soc"
osource "C:/Users/Administrador/.platformio/packages/framework-zephyr@3.40200.0/soc/intel/lakemont/Kconfig.soc"
osource "C:/Users/Administrador/.platformio/packages/framework-zephyr@3.40200.0/soc/intel/intel_socfpga_std/Kconfig.soc"
osource "C:/Users/Administrador/.platformio/packages/framework-zephyr@3.40200.0/soc/intel/intel_socfpga/Kconfig.soc"
osource "C:/Users/Administrador/.platformio/packages/framework-zephyr@3.40200.0/soc/intel/intel_niosv/Kconfig.soc"
osource "C:/Users/Administrador/.platformio/packages/framework-zephyr@3.40200.0/soc/intel/intel_ish/Kconfig.soc"
osource "C:/Users/Administrador/.platformio/packages/framework-zephyr@3.40200.0/soc/intel/intel_adsp/Kconfig.soc"
osource "C:/Users/Administrador/.platformio/packages/framework-zephyr@3.40200.0/soc/intel/elkhart_lake/Kconfig.soc"
osource "C:/Users/Administrador/.platformio/packages/framework-zephyr@3.40200.0/soc/intel/atom/Kconfig.soc"
osource "C:/Users/Administrador/.platformio/packages/framework-zephyr@3.40200.0/soc/intel/apollo_lake/Kconfig.soc"
osource "C:/Users/Administrador/.platformio/packages/framework-zephyr@3.40200.0/soc/intel/alder_lake/Kconfig.soc"
osource "C:/Users/Administrador/.platformio/packages/framework-zephyr@3.40200.0/soc/infineon/cat3/Kconfig.soc"
osource "C:/Users/Administrador/.platformio/packages/framework-zephyr@3.40200.0/soc/infineon/cat1c/Kconfig.soc"
osource "C:/Users/Administrador/.platformio/packages/framework-zephyr@3.40200.0/soc/infineon/cat1b/Kconfig.soc"
osource "C:/Users/Administrador/.platformio/packages/framework-zephyr@3.40200.0/soc/infineon/cat1a/Kconfig.soc"
osource "C:/Users/Administrador/.platformio/packages/framework-zephyr@3.40200.0/soc/gd/gd32/Kconfig.soc"
osource "C:/Users/Administrador/.platformio/packages/framework-zephyr@3.40200.0/soc/gaisler/leon3/Kconfig.soc"
osource "C:/Users/Administrador/.platformio/packages/framework-zephyr@3.40200.0/soc/gaisler/gr716a/Kconfig.soc"
osource "C:/Users/Administrador/.platformio/packages/framework-zephyr@3.40200.0/soc/espressif/Kconfig.soc"
osource "C:/Users/Administrador/.platformio/packages/framework-zephyr@3.40200.0/soc/ene/kb1200/Kconfig.soc"
osource "C:/Users/Administrador/.platformio/packages/framework-zephyr@3.40200.0/soc/ene/kb106x/Kconfig.soc"
osource "C:/Users/Administrador/.platformio/packages/framework-zephyr@3.40200.0/soc/efinix/sapphire/Kconfig.soc"
osource "C:/Users/Administrador/.platformio/packages/framework-zephyr@3.40200.0/soc/cdns/xtensa_sample_controller/Kconfig.soc"
osource "C:/Users/Administrador/.platformio/packages/framework-zephyr@3.40200.0/soc/cdns/sample_controller32/Kconfig.soc"
osource "C:/Users/Administrador/.platformio/packages/framework-zephyr@3.40200.0/soc/cdns/dc233c/Kconfig.soc"
osource "C:/Users/Administrador/.platformio/packages/framework-zephyr@3.40200.0/soc/brcm/bcmvk/Kconfig.soc"
osource "C:/Users/Administrador/.platformio/packages/framework-zephyr@3.40200.0/soc/brcm/bcm2712/Kconfig.soc"
osource "C:/Users/Administrador/.platformio/packages/framework-zephyr@3.40200.0/soc/brcm/bcm2711/Kconfig.soc"
osource "C:/Users/Administrador/.platformio/packages/framework-zephyr@3.40200.0/soc/bflb/Kconfig.soc"
osource "C:/Users/Administrador/.platformio/packages/framework-zephyr@3.40200.0/soc/atmel/sam0/Kconfig.soc"
osource "C:/Users/Administrador/.platformio/packages/framework-zephyr@3.40200.0/soc/atmel/sam/Kconfig.soc"
osource "C:/Users/Administrador/.platformio/packages/framework-zephyr@3.40200.0/soc/aspeed/Kconfig.soc"
osource "C:/Users/Administrador/.platformio/packages/framework-zephyr@3.40200.0/soc/arm/Kconfig.soc"
osource "C:/Users/Administrador/.platformio/packages/framework-zephyr@3.40200.0/soc/arm/beetle/Kconfig.soc"
osource "C:/Users/Administrador/.platformio/packages/framework-zephyr@3.40200.0/soc/antmicro/myra/Kconfig.soc"
osource "C:/Users/Administrador/.platformio/packages/framework-zephyr@3.40200.0/soc/andestech/Kconfig.soc"
osource "C:/Users/Administrador/.platformio/packages/framework-zephyr@3.40200.0/soc/amd/acp_6_0/Kconfig.soc"
osource "C:/Users/Administrador/.platformio/packages/framework-zephyr@3.40200.0/soc/ambiq/Kconfig.soc"
osource "C:/Users/Administrador/.platformio/packages/framework-zephyr@3.40200.0/soc/aesc/Kconfig.soc"
osource "C:/Users/Administrador/.platformio/packages/framework-zephyr@3.40200.0/soc/adi/max32/Kconfig.soc"
```
