## .pio/build/frdm_kl25z/Kconfig/soc/Kconfig.sysbuild
```kconfig
# Load Sysbuild SoC Kconfig descriptions.
osource "C:/Users/Administrador/.platformio/packages/framework-zephyr@3.40200.0/soc/xlnx/zynqmp/Kconfig.sysbuild"
osource "C:/Users/Administrador/.platformio/packages/framework-zephyr@3.40200.0/soc/xlnx/zynq7000/Kconfig.sysbuild"
osource "C:/Users/Administrador/.platformio/packages/framework-zephyr@3.40200.0/soc/xlnx/versalnet/Kconfig.sysbuild"
osource "C:/Users/Administrador/.platformio/packages/framework-zephyr@3.40200.0/soc/xlnx/versal2/Kconfig.sysbuild"
osource "C:/Users/Administrador/.platformio/packages/framework-zephyr@3.40200.0/soc/xen/Kconfig.sysbuild"
osource "C:/Users/Administrador/.platformio/packages/framework-zephyr@3.40200.0/soc/wch/ch32v/Kconfig.sysbuild"
osource "C:/Users/Administrador/.platformio/packages/framework-zephyr@3.40200.0/soc/ti/simplelink/Kconfig.sysbuild"
osource "C:/Users/Administrador/.platformio/packages/framework-zephyr@3.40200.0/soc/ti/mspm0/Kconfig.sysbuild"
osource "C:/Users/Administrador/.platformio/packages/framework-zephyr@3.40200.0/soc/ti/lm3s6965/Kconfig.sysbuild"
osource "C:/Users/Administrador/.platformio/packages/framework-zephyr@3.40200.0/soc/ti/k3/Kconfig.sysbuild"
osource "C:/Users/Administrador/.platformio/packages/framework-zephyr@3.40200.0/soc/telink/tlsr/Kconfig.sysbuild"
osource "C:/Users/Administrador/.platformio/packages/framework-zephyr@3.40200.0/soc/starfive/jh71xx/Kconfig.sysbuild"
osource "C:/Users/Administrador/.platformio/packages/framework-zephyr@3.40200.0/soc/st/stm32/Kconfig.sysbuild"
osource "C:/Users/Administrador/.platformio/packages/framework-zephyr@3.40200.0/soc/snps/qemu_arc/Kconfig.sysbuild"
osource "C:/Users/Administrador/.platformio/packages/framework-zephyr@3.40200.0/soc/snps/nsim/arc_v/Kconfig.sysbuild"
osource "C:/Users/Administrador/.platformio/packages/framework-zephyr@3.40200.0/soc/snps/nsim/arc_classic/Kconfig.sysbuild"
osource "C:/Users/Administrador/.platformio/packages/framework-zephyr@3.40200.0/soc/snps/hsdk4xd/Kconfig.sysbuild"
osource "C:/Users/Administrador/.platformio/packages/framework-zephyr@3.40200.0/soc/snps/hsdk/Kconfig.sysbuild"
osource "C:/Users/Administrador/.platformio/packages/framework-zephyr@3.40200.0/soc/snps/emsk/Kconfig.sysbuild"
osource "C:/Users/Administrador/.platformio/packages/framework-zephyr@3.40200.0/soc/snps/emsdp/Kconfig.sysbuild"
osource "C:/Users/Administrador/.platformio/packages/framework-zephyr@3.40200.0/soc/snps/arc_iot/Kconfig.sysbuild"
osource "C:/Users/Administrador/.platformio/packages/framework-zephyr@3.40200.0/soc/silabs/Kconfig.sysbuild"
osource "C:/Users/Administrador/.platformio/packages/framework-zephyr@3.40200.0/soc/sifive/sifive_freedom/Kconfig.sysbuild"
osource "C:/Users/Administrador/.platformio/packages/framework-zephyr@3.40200.0/soc/sensry/Kconfig.sysbuild"
osource "C:/Users/Administrador/.platformio/packages/framework-zephyr@3.40200.0/soc/rockchip/Kconfig.sysbuild"
osource "C:/Users/Administrador/.platformio/packages/framework-zephyr@3.40200.0/soc/renode/riscv_virtual/Kconfig.sysbuild"
osource "C:/Users/Administrador/.platformio/packages/framework-zephyr@3.40200.0/soc/renode/cortex_r8_virtual/Kconfig.sysbuild"
osource "C:/Users/Administrador/.platformio/packages/framework-zephyr@3.40200.0/soc/renesas/smartbond/Kconfig.sysbuild"
osource "C:/Users/Administrador/.platformio/packages/framework-zephyr@3.40200.0/soc/renesas/rz/Kconfig.sysbuild"
osource "C:/Users/Administrador/.platformio/packages/framework-zephyr@3.40200.0/soc/renesas/rx/Kconfig.sysbuild"
osource "C:/Users/Administrador/.platformio/packages/framework-zephyr@3.40200.0/soc/renesas/rcar/Kconfig.sysbuild"
osource "C:/Users/Administrador/.platformio/packages/framework-zephyr@3.40200.0/soc/renesas/ra/Kconfig.sysbuild"
osource "C:/Users/Administrador/.platformio/packages/framework-zephyr@3.40200.0/soc/realtek/ec/Kconfig.sysbuild"
osource "C:/Users/Administrador/.platformio/packages/framework-zephyr@3.40200.0/soc/raspberrypi/rpi_pico/Kconfig.sysbuild"
osource "C:/Users/Administrador/.platformio/packages/framework-zephyr@3.40200.0/soc/quicklogic/eos_s3/Kconfig.sysbuild"
osource "C:/Users/Administrador/.platformio/packages/framework-zephyr@3.40200.0/soc/qemu/virt_riscv/Kconfig.sysbuild"
osource "C:/Users/Administrador/.platformio/packages/framework-zephyr@3.40200.0/soc/qemu/malta/Kconfig.sysbuild"
osource "C:/Users/Administrador/.platformio/packages/framework-zephyr@3.40200.0/soc/openisa/rv32m1/Kconfig.sysbuild"
osource "C:/Users/Administrador/.platformio/packages/framework-zephyr@3.40200.0/soc/openhwgroup/cva6/Kconfig.sysbuild"
osource "C:/Users/Administrador/.platformio/packages/framework-zephyr@3.40200.0/soc/oct/osd32mp15x/Kconfig.sysbuild"
osource "C:/Users/Administrador/.platformio/packages/framework-zephyr@3.40200.0/soc/nxp/s32/Kconfig.sysbuild"
osource "C:/Users/Administrador/.platformio/packages/framework-zephyr@3.40200.0/soc/nxp/rw/Kconfig.sysbuild"
osource "C:/Users/Administrador/.platformio/packages/framework-zephyr@3.40200.0/soc/nxp/mcx/Kconfig.sysbuild"
osource "C:/Users/Administrador/.platformio/packages/framework-zephyr@3.40200.0/soc/nxp/lpc/Kconfig.sysbuild"
osource "C:/Users/Administrador/.platformio/packages/framework-zephyr@3.40200.0/soc/nxp/layerscape/Kconfig.sysbuild"
osource "C:/Users/Administrador/.platformio/packages/framework-zephyr@3.40200.0/soc/nxp/kinetis/Kconfig.sysbuild"
osource "C:/Users/Administrador/.platformio/packages/framework-zephyr@3.40200.0/soc/nxp/imxrt/Kconfig.sysbuild"
osource "C:/Users/Administrador/.platformio/packages/framework-zephyr@3.40200.0/soc/nxp/imx/Kconfig.sysbuild"
osource "C:/Users/Administrador/.platformio/packages/framework-zephyr@3.40200.0/soc/nuvoton/numicro/Kconfig.sysbuild"
osource "C:/Users/Administrador/.platformio/packages/framework-zephyr@3.40200.0/soc/nuvoton/numaker/Kconfig.sysbuild"
osource "C:/Users/Administrador/.platformio/packages/framework-zephyr@3.40200.0/soc/nuvoton/npcx/Kconfig.sysbuild"
osource "C:/Users/Administrador/.platformio/packages/framework-zephyr@3.40200.0/soc/nuvoton/npcm/Kconfig.sysbuild"
osource "C:/Users/Administrador/.platformio/packages/framework-zephyr@3.40200.0/soc/nordic/Kconfig.sysbuild"
osource "C:/Users/Administrador/.platformio/packages/framework-zephyr@3.40200.0/soc/neorv32/Kconfig.sysbuild"
osource "C:/Users/Administrador/.platformio/packages/framework-zephyr@3.40200.0/soc/native/inf_clock/Kconfig.sysbuild"
osource "C:/Users/Administrador/.platformio/packages/framework-zephyr@3.40200.0/soc/microchip/sam/Kconfig.sysbuild"
osource "C:/Users/Administrador/.platformio/packages/framework-zephyr@3.40200.0/soc/microchip/miv/Kconfig.sysbuild"
osource "C:/Users/Administrador/.platformio/packages/framework-zephyr@3.40200.0/soc/microchip/mec/Kconfig.sysbuild"
osource "C:/Users/Administrador/.platformio/packages/framework-zephyr@3.40200.0/soc/mediatek/mt8xxx/Kconfig.sysbuild"
osource "C:/Users/Administrador/.platformio/packages/framework-zephyr@3.40200.0/soc/lowrisc/opentitan/Kconfig.sysbuild"
osource "C:/Users/Administrador/.platformio/packages/framework-zephyr@3.40200.0/soc/litex/litex_vexriscv/Kconfig.sysbuild"
osource "C:/Users/Administrador/.platformio/packages/framework-zephyr@3.40200.0/soc/ite/ec/Kconfig.sysbuild"
osource "C:/Users/Administrador/.platformio/packages/framework-zephyr@3.40200.0/soc/intel/raptor_lake/Kconfig.sysbuild"
osource "C:/Users/Administrador/.platformio/packages/framework-zephyr@3.40200.0/soc/intel/lakemont/Kconfig.sysbuild"
osource "C:/Users/Administrador/.platformio/packages/framework-zephyr@3.40200.0/soc/intel/intel_socfpga_std/Kconfig.sysbuild"
osource "C:/Users/Administrador/.platformio/packages/framework-zephyr@3.40200.0/soc/intel/intel_socfpga/Kconfig.sysbuild"
osource "C:/Users/Administrador/.platformio/packages/framework-zephyr@3.40200.0/soc/intel/intel_niosv/Kconfig.sysbuild"
osource "C:/Users/Administrador/.platformio/packages/framework-zephyr@3.40200.0/soc/intel/intel_ish/Kconfig.sysbuild"
osource "C:/Users/Administrador/.platformio/packages/framework-zephyr@3.40200.0/soc/intel/intel_adsp/Kconfig.sysbuild"
osource "C:/Users/Administrador/.platformio/packages/framework-zephyr@3.40200.0/soc/intel/elkhart_lake/Kconfig.sysbuild"
osource "C:/Users/Administrador/.platformio/packages/framework-zephyr@3.40200.0/soc/intel/atom/Kconfig.sysbuild"
osource "C:/Users/Administrador/.platformio/packages/framework-zephyr@3.40200.0/soc/intel/apollo_lake/Kconfig.sysbuild"
osource "C:/Users/Administrador/.platformio/packages/framework-zephyr@3.40200.0/soc/intel/alder_lake/Kconfig.sysbuild"
osource "C:/Users/Administrador/.platformio/packages/framework-zephyr@3.40200.0/soc/infineon/cat3/Kconfig.sysbuild"
osource "C:/Users/Administrador/.platformio/packages/framework-zephyr@3.40200.0/soc/infineon/cat1c/Kconfig.sysbuild"
osource "C:/Users/Administrador/.platformio/packages/framework-zephyr@3.40200.0/soc/infineon/cat1b/Kconfig.sysbuild"
osource "C:/Users/Administrador/.platformio/packages/framework-zephyr@3.40200.0/soc/infineon/cat1a/Kconfig.sysbuild"
osource "C:/Users/Administrador/.platformio/packages/framework-zephyr@3.40200.0/soc/gd/gd32/Kconfig.sysbuild"
osource "C:/Users/Administrador/.platformio/packages/framework-zephyr@3.40200.0/soc/gaisler/leon3/Kconfig.sysbuild"
osource "C:/Users/Administrador/.platformio/packages/framework-zephyr@3.40200.0/soc/gaisler/gr716a/Kconfig.sysbuild"
osource "C:/Users/Administrador/.platformio/packages/framework-zephyr@3.40200.0/soc/espressif/Kconfig.sysbuild"
osource "C:/Users/Administrador/.platformio/packages/framework-zephyr@3.40200.0/soc/ene/kb1200/Kconfig.sysbuild"
osource "C:/Users/Administrador/.platformio/packages/framework-zephyr@3.40200.0/soc/ene/kb106x/Kconfig.sysbuild"
osource "C:/Users/Administrador/.platformio/packages/framework-zephyr@3.40200.0/soc/efinix/sapphire/Kconfig.sysbuild"
osource "C:/Users/Administrador/.platformio/packages/framework-zephyr@3.40200.0/soc/cdns/xtensa_sample_controller/Kconfig.sysbuild"
osource "C:/Users/Administrador/.platformio/packages/framework-zephyr@3.40200.0/soc/cdns/sample_controller32/Kconfig.sysbuild"
osource "C:/Users/Administrador/.platformio/packages/framework-zephyr@3.40200.0/soc/cdns/dc233c/Kconfig.sysbuild"
osource "C:/Users/Administrador/.platformio/packages/framework-zephyr@3.40200.0/soc/brcm/bcmvk/Kconfig.sysbuild"
osource "C:/Users/Administrador/.platformio/packages/framework-zephyr@3.40200.0/soc/brcm/bcm2712/Kconfig.sysbuild"
osource "C:/Users/Administrador/.platformio/packages/framework-zephyr@3.40200.0/soc/brcm/bcm2711/Kconfig.sysbuild"
osource "C:/Users/Administrador/.platformio/packages/framework-zephyr@3.40200.0/soc/bflb/Kconfig.sysbuild"
osource "C:/Users/Administrador/.platformio/packages/framework-zephyr@3.40200.0/soc/atmel/sam0/Kconfig.sysbuild"
osource "C:/Users/Administrador/.platformio/packages/framework-zephyr@3.40200.0/soc/atmel/sam/Kconfig.sysbuild"
osource "C:/Users/Administrador/.platformio/packages/framework-zephyr@3.40200.0/soc/aspeed/Kconfig.sysbuild"
osource "C:/Users/Administrador/.platformio/packages/framework-zephyr@3.40200.0/soc/arm/Kconfig.sysbuild"
osource "C:/Users/Administrador/.platformio/packages/framework-zephyr@3.40200.0/soc/arm/beetle/Kconfig.sysbuild"
osource "C:/Users/Administrador/.platformio/packages/framework-zephyr@3.40200.0/soc/antmicro/myra/Kconfig.sysbuild"
osource "C:/Users/Administrador/.platformio/packages/framework-zephyr@3.40200.0/soc/andestech/Kconfig.sysbuild"
osource "C:/Users/Administrador/.platformio/packages/framework-zephyr@3.40200.0/soc/amd/acp_6_0/Kconfig.sysbuild"
osource "C:/Users/Administrador/.platformio/packages/framework-zephyr@3.40200.0/soc/ambiq/Kconfig.sysbuild"
osource "C:/Users/Administrador/.platformio/packages/framework-zephyr@3.40200.0/soc/aesc/Kconfig.sysbuild"
osource "C:/Users/Administrador/.platformio/packages/framework-zephyr@3.40200.0/soc/adi/max32/Kconfig.sysbuild"
```
