## .pio/build/frdm_kl25z/Kconfig/soc/Kconfig.defconfig
```kconfig
# Load Zephyr SoC defconfig descriptions.
osource "C:/Users/Administrador/.platformio/packages/framework-zephyr@3.40200.0/soc/xlnx/zynqmp/Kconfig.defconfig"
osource "C:/Users/Administrador/.platformio/packages/framework-zephyr@3.40200.0/soc/xlnx/zynq7000/Kconfig.defconfig"
osource "C:/Users/Administrador/.platformio/packages/framework-zephyr@3.40200.0/soc/xlnx/versalnet/Kconfig.defconfig"
osource "C:/Users/Administrador/.platformio/packages/framework-zephyr@3.40200.0/soc/xlnx/versal2/Kconfig.defconfig"
osource "C:/Users/Administrador/.platformio/packages/framework-zephyr@3.40200.0/soc/xen/Kconfig.defconfig"
osource "C:/Users/Administrador/.platformio/packages/framework-zephyr@3.40200.0/soc/wch/ch32v/Kconfig.defconfig"
osource "C:/Users/Administrador/.platformio/packages/framework-zephyr@3.40200.0/soc/ti/simplelink/Kconfig.defconfig"
osource "C:/Users/Administrador/.platformio/packages/framework-zephyr@3.40200.0/soc/ti/mspm0/Kconfig.defconfig"
osource "C:/Users/Administrador/.platformio/packages/framework-zephyr@3.40200.0/soc/ti/lm3s6965/Kconfig.defconfig"
osource "C:/Users/Administrador/.platformio/packages/framework-zephyr@3.40200.0/soc/ti/k3/Kconfig.defconfig"
osource "C:/Users/Administrador/.platformio/packages/framework-zephyr@3.40200.0/soc/telink/tlsr/Kconfig.defconfig"
osource "C:/Users/Administrador/.platformio/packages/framework-zephyr@3.40200.0/soc/starfive/jh71xx/Kconfig.defconfig"
osource "C:/Users/Administrador/.platformio/packages/framework-zephyr@3.40200.0/soc/st/stm32/Kconfig.defconfig"
osource "C:/Users/Administrador/.platformio/packages/framework-zephyr@3.40200.0/soc/snps/qemu_arc/Kconfig.defconfig"
osource "C:/Users/Administrador/.platformio/packages/framework-zephyr@3.40200.0/soc/snps/nsim/arc_v/Kconfig.defconfig"
osource "C:/Users/Administrador/.platformio/packages/framework-zephyr@3.40200.0/soc/snps/nsim/arc_classic/Kconfig.defconfig"
osource "C:/Users/Administrador/.platformio/packages/framework-zephyr@3.40200.0/soc/snps/hsdk4xd/Kconfig.defconfig"
osource "C:/Users/Administrador/.platformio/packages/framework-zephyr@3.40200.0/soc/snps/hsdk/Kconfig.defconfig"
osource "C:/Users/Administrador/.platformio/packages/framework-zephyr@3.40200.0/soc/snps/emsk/Kconfig.defconfig"
osource "C:/Users/Administrador/.platformio/packages/framework-zephyr@3.40200.0/soc/snps/emsdp/Kconfig.defconfig"
osource "C:/Users/Administrador/.platformio/packages/framework-zephyr@3.40200.0/soc/snps/arc_iot/Kconfig.defconfig"
osource "C:/Users/Administrador/.platformio/packages/framework-zephyr@3.40200.0/soc/silabs/Kconfig.defconfig"
osource "C:/Users/Administrador/.platformio/packages/framework-zephyr@3.40200.0/soc/sifive/sifive_freedom/Kconfig.defconfig"
osource "C:/Users/Administrador/.platformio/packages/framework-zephyr@3.40200.0/soc/sensry/Kconfig.defconfig"
osource "C:/Users/Administrador/.platformio/packages/framework-zephyr@3.40200.0/soc/rockchip/Kconfig.defconfig"
osource "C:/Users/Administrador/.platformio/packages/framework-zephyr@3.40200.0/soc/renode/riscv_virtual/Kconfig.defconfig"
osource "C:/Users/Administrador/.platformio/packages/framework-zephyr@3.40200.0/soc/renode/cortex_r8_virtual/Kconfig.defconfig"
osource "C:/Users/Administrador/.platformio/packages/framework-zephyr@3.40200.0/soc/renesas/smartbond/Kconfig.defconfig"
osource "C:/Users/Administrador/.platformio/packages/framework-zephyr@3.40200.0/soc/renesas/rz/Kconfig.defconfig"
osource "C:/Users/Administrador/.platformio/packages/framework-zephyr@3.40200.0/soc/renesas/rx/Kconfig.defconfig"
osource "C:/Users/Administrador/.platformio/packages/framework-zephyr@3.40200.0/soc/renesas/rcar/Kconfig.defconfig"
osource "C:/Users/Administrador/.platformio/packages/framework-zephyr@3.40200.0/soc/renesas/ra/Kconfig.defconfig"
osource "C:/Users/Administrador/.platformio/packages/framework-zephyr@3.40200.0/soc/realtek/ec/Kconfig.defconfig"
osource "C:/Users/Administrador/.platformio/packages/framework-zephyr@3.40200.0/soc/raspberrypi/rpi_pico/Kconfig.defconfig"
osource "C:/Users/Administrador/.platformio/packages/framework-zephyr@3.40200.0/soc/quicklogic/eos_s3/Kconfig.defconfig"
osource "C:/Users/Administrador/.platformio/packages/framework-zephyr@3.40200.0/soc/qemu/virt_riscv/Kconfig.defconfig"
osource "C:/Users/Administrador/.platformio/packages/framework-zephyr@3.40200.0/soc/qemu/malta/Kconfig.defconfig"
osource "C:/Users/Administrador/.platformio/packages/framework-zephyr@3.40200.0/soc/openisa/rv32m1/Kconfig.defconfig"
osource "C:/Users/Administrador/.platformio/packages/framework-zephyr@3.40200.0/soc/openhwgroup/cva6/Kconfig.defconfig"
osource "C:/Users/Administrador/.platformio/packages/framework-zephyr@3.40200.0/soc/oct/osd32mp15x/Kconfig.defconfig"
osource "C:/Users/Administrador/.platformio/packages/framework-zephyr@3.40200.0/soc/nxp/s32/Kconfig.defconfig"
osource "C:/Users/Administrador/.platformio/packages/framework-zephyr@3.40200.0/soc/nxp/rw/Kconfig.defconfig"
osource "C:/Users/Administrador/.platformio/packages/framework-zephyr@3.40200.0/soc/nxp/mcx/Kconfig.defconfig"
osource "C:/Users/Administrador/.platformio/packages/framework-zephyr@3.40200.0/soc/nxp/lpc/Kconfig.defconfig"
osource "C:/Users/Administrador/.platformio/packages/framework-zephyr@3.40200.0/soc/nxp/layerscape/Kconfig.defconfig"
osource "C:/Users/Administrador/.platformio/packages/framework-zephyr@3.40200.0/soc/nxp/kinetis/Kconfig.defconfig"
osource "C:/Users/Administrador/.platformio/packages/framework-zephyr@3.40200.0/soc/nxp/imxrt/Kconfig.defconfig"
osource "C:/Users/Administrador/.platformio/packages/framework-zephyr@3.40200.0/soc/nxp/imx/Kconfig.defconfig"
osource "C:/Users/Administrador/.platformio/packages/framework-zephyr@3.40200.0/soc/nuvoton/numicro/Kconfig.defconfig"
osource "C:/Users/Administrador/.platformio/packages/framework-zephyr@3.40200.0/soc/nuvoton/numaker/Kconfig.defconfig"
osource "C:/Users/Administrador/.platformio/packages/framework-zephyr@3.40200.0/soc/nuvoton/npcx/Kconfig.defconfig"
osource "C:/Users/Administrador/.platformio/packages/framework-zephyr@3.40200.0/soc/nuvoton/npcm/Kconfig.defconfig"
osource "C:/Users/Administrador/.platformio/packages/framework-zephyr@3.40200.0/soc/nordic/Kconfig.defconfig"
osource "C:/Users/Administrador/.platformio/packages/framework-zephyr@3.40200.0/soc/neorv32/Kconfig.defconfig"
osource "C:/Users/Administrador/.platformio/packages/framework-zephyr@3.40200.0/soc/native/inf_clock/Kconfig.defconfig"
osource "C:/Users/Administrador/.platformio/packages/framework-zephyr@3.40200.0/soc/microchip/sam/Kconfig.defconfig"
osource "C:/Users/Administrador/.platformio/packages/framework-zephyr@3.40200.0/soc/microchip/miv/Kconfig.defconfig"
osource "C:/Users/Administrador/.platformio/packages/framework-zephyr@3.40200.0/soc/microchip/mec/Kconfig.defconfig"
osource "C:/Users/Administrador/.platformio/packages/framework-zephyr@3.40200.0/soc/mediatek/mt8xxx/Kconfig.defconfig"
osource "C:/Users/Administrador/.platformio/packages/framework-zephyr@3.40200.0/soc/lowrisc/opentitan/Kconfig.defconfig"
osource "C:/Users/Administrador/.platformio/packages/framework-zephyr@3.40200.0/soc/litex/litex_vexriscv/Kconfig.defconfig"
osource "C:/Users/Administrador/.platformio/packages/framework-zephyr@3.40200.0/soc/ite/ec/Kconfig.defconfig"
osource "C:/Users/Administrador/.platformio/packages/framework-zephyr@3.40200.0/soc/intel/raptor_lake/Kconfig.defconfig"
osource "C:/Users/Administrador/.platformio/packages/framework-zephyr@3.40200.0/soc/intel/lakemont/Kconfig.defconfig"
osource "C:/Users/Administrador/.platformio/packages/framework-zephyr@3.40200.0/soc/intel/intel_socfpga_std/Kconfig.defconfig"
osource "C:/Users/Administrador/.platformio/packages/framework-zephyr@3.40200.0/soc/intel/intel_socfpga/Kconfig.defconfig"
osource "C:/Users/Administrador/.platformio/packages/framework-zephyr@3.40200.0/soc/intel/intel_niosv/Kconfig.defconfig"
osource "C:/Users/Administrador/.platformio/packages/framework-zephyr@3.40200.0/soc/intel/intel_ish/Kconfig.defconfig"
osource "C:/Users/Administrador/.platformio/packages/framework-zephyr@3.40200.0/soc/intel/intel_adsp/Kconfig.defconfig"
osource "C:/Users/Administrador/.platformio/packages/framework-zephyr@3.40200.0/soc/intel/elkhart_lake/Kconfig.defconfig"
osource "C:/Users/Administrador/.platformio/packages/framework-zephyr@3.40200.0/soc/intel/atom/Kconfig.defconfig"
osource "C:/Users/Administrador/.platformio/packages/framework-zephyr@3.40200.0/soc/intel/apollo_lake/Kconfig.defconfig"
osource "C:/Users/Administrador/.platformio/packages/framework-zephyr@3.40200.0/soc/intel/alder_lake/Kconfig.defconfig"
osource "C:/Users/Administrador/.platformio/packages/framework-zephyr@3.40200.0/soc/infineon/cat3/Kconfig.defconfig"
osource "C:/Users/Administrador/.platformio/packages/framework-zephyr@3.40200.0/soc/infineon/cat1c/Kconfig.defconfig"
osource "C:/Users/Administrador/.platformio/packages/framework-zephyr@3.40200.0/soc/infineon/cat1b/Kconfig.defconfig"
osource "C:/Users/Administrador/.platformio/packages/framework-zephyr@3.40200.0/soc/infineon/cat1a/Kconfig.defconfig"
osource "C:/Users/Administrador/.platformio/packages/framework-zephyr@3.40200.0/soc/gd/gd32/Kconfig.defconfig"
osource "C:/Users/Administrador/.platformio/packages/framework-zephyr@3.40200.0/soc/gaisler/leon3/Kconfig.defconfig"
osource "C:/Users/Administrador/.platformio/packages/framework-zephyr@3.40200.0/soc/gaisler/gr716a/Kconfig.defconfig"
osource "C:/Users/Administrador/.platformio/packages/framework-zephyr@3.40200.0/soc/espressif/Kconfig.defconfig"
osource "C:/Users/Administrador/.platformio/packages/framework-zephyr@3.40200.0/soc/ene/kb1200/Kconfig.defconfig"
osource "C:/Users/Administrador/.platformio/packages/framework-zephyr@3.40200.0/soc/ene/kb106x/Kconfig.defconfig"
osource "C:/Users/Administrador/.platformio/packages/framework-zephyr@3.40200.0/soc/efinix/sapphire/Kconfig.defconfig"
osource "C:/Users/Administrador/.platformio/packages/framework-zephyr@3.40200.0/soc/cdns/xtensa_sample_controller/Kconfig.defconfig"
osource "C:/Users/Administrador/.platformio/packages/framework-zephyr@3.40200.0/soc/cdns/sample_controller32/Kconfig.defconfig"
osource "C:/Users/Administrador/.platformio/packages/framework-zephyr@3.40200.0/soc/cdns/dc233c/Kconfig.defconfig"
osource "C:/Users/Administrador/.platformio/packages/framework-zephyr@3.40200.0/soc/brcm/bcmvk/Kconfig.defconfig"
osource "C:/Users/Administrador/.platformio/packages/framework-zephyr@3.40200.0/soc/brcm/bcm2712/Kconfig.defconfig"
osource "C:/Users/Administrador/.platformio/packages/framework-zephyr@3.40200.0/soc/brcm/bcm2711/Kconfig.defconfig"
osource "C:/Users/Administrador/.platformio/packages/framework-zephyr@3.40200.0/soc/bflb/Kconfig.defconfig"
osource "C:/Users/Administrador/.platformio/packages/framework-zephyr@3.40200.0/soc/atmel/sam0/Kconfig.defconfig"
osource "C:/Users/Administrador/.platformio/packages/framework-zephyr@3.40200.0/soc/atmel/sam/Kconfig.defconfig"
osource "C:/Users/Administrador/.platformio/packages/framework-zephyr@3.40200.0/soc/aspeed/Kconfig.defconfig"
osource "C:/Users/Administrador/.platformio/packages/framework-zephyr@3.40200.0/soc/arm/Kconfig.defconfig"
osource "C:/Users/Administrador/.platformio/packages/framework-zephyr@3.40200.0/soc/arm/beetle/Kconfig.defconfig"
osource "C:/Users/Administrador/.platformio/packages/framework-zephyr@3.40200.0/soc/antmicro/myra/Kconfig.defconfig"
osource "C:/Users/Administrador/.platformio/packages/framework-zephyr@3.40200.0/soc/andestech/Kconfig.defconfig"
osource "C:/Users/Administrador/.platformio/packages/framework-zephyr@3.40200.0/soc/amd/acp_6_0/Kconfig.defconfig"
osource "C:/Users/Administrador/.platformio/packages/framework-zephyr@3.40200.0/soc/ambiq/Kconfig.defconfig"
osource "C:/Users/Administrador/.platformio/packages/framework-zephyr@3.40200.0/soc/aesc/Kconfig.defconfig"
osource "C:/Users/Administrador/.platformio/packages/framework-zephyr@3.40200.0/soc/adi/max32/Kconfig.defconfig"
```
